## components/fw_ota_lte/Kconfig
```kconfig
menu "Firmware LTE OTA (fw_ota_lte)"

    config FW_OTA_LTE_AUTO_CHECK
        bool "Auto-check firmware after LTE is up"
        default y
        help
            After boot, wait for cellular registration then POST firmware-check.
            Repeats every FW_OTA_LTE_AUTO_INTERVAL_H hours. Force is always off
            for auto checks (SoftAP/serial Force still works for lab).

    config FW_OTA_LTE_CHECK_URL
        string "Firmware-check POST URL"
        default "https://api.trafyn.info/workflow-engine/realm/1/user/1/v1/execution/service/runWithNoAuth/get-latest-device-firmware?refreshCache=true"
        help
            Auto-check POSTs this URL for get-latest-device-firmware.
            NVS ota_manif overrides if non-empty. SoftAP/serial can also set it.

    config FW_OTA_LTE_AUTH_HEADER
        string "Optional Authorization header value (empty = omit)"
        default ""
        help
            If non-empty, sent as Authorization on the firmware-check POST.
            Leave empty to omit the header. Do not commit secrets here.

    config FW_OTA_LTE_SYSTEM_USER_ID
        string "Optional x-nc-system-user-id (empty = omit)"
        default ""
        help
            If non-empty, sent as x-nc-system-user-id on the firmware-check POST.
            Leave empty to omit the header.

    config FW_OTA_LTE_MANUFACTURER
        string "Trafyn manufacturer"
        default "Espressif Systems"
        help
            Value for input.manufacturer in the firmware-check POST body.

    config FW_OTA_LTE_DEVICE_TYPE
        string "Trafyn deviceType"
        default "fleet monitor"
        help
            Value for input.deviceType in the firmware-check POST body.

    config FW_OTA_LTE_AUTO_WAIT_SEC
        int "Max seconds to wait for LTE registration before first check"
        range 30 600
        default 90
        depends on FW_OTA_LTE_AUTO_CHECK

    config FW_OTA_LTE_AUTO_INTERVAL_H
        int "Hours between auto OTA checks"
        range 1 168
        default 24
        depends on FW_OTA_LTE_AUTO_CHECK

endmenu
```

## components/net_lte/Kconfig
```kconfig
menu "EC200U LTE (net_lte)"

    config NET_LTE_ENABLE
        bool "Enable EC200U LTE UART / PPP"
        default y
        help
            Uses UART1 GPIO16 (ESP TX → modem RX) / GPIO17 (ESP RX ← modem TX).
            Matches the printed carrier PCB (KiCad Vehical Telematics Design).
            Requires the modem wired to the ESP32-C6 (not only PC USB).

    config NET_LTE_UART_PORT
        int "UART port number"
        default 1
        depends on NET_LTE_ENABLE

    config NET_LTE_UART_TX_GPIO
        int "Modem UART TX GPIO (ESP → modem RX)"
        default 16
        depends on NET_LTE_ENABLE

    config NET_LTE_UART_RX_GPIO
        int "Modem UART RX GPIO (ESP ← modem TX)"
        default 17
        depends on NET_LTE_ENABLE

    config NET_LTE_UART_BAUD
        int "Modem UART baud"
        default 115200
        depends on NET_LTE_ENABLE

    config NET_LTE_APN
        string "Cellular APN"
        default "airtelgprs.com"
        depends on NET_LTE_ENABLE

    config NET_LTE_GPS_ENABLE
        bool "Enable EC200U GNSS for uplink lat/lng"
        default y
        depends on NET_LTE_ENABLE

    config NET_LTE_GPS_REFRESH_S
        int "GNSS refresh interval (seconds)"
        default 10
        range 5 120
        depends on NET_LTE_GPS_ENABLE

    config NET_LTE_GPS_MAX_AGE_S
        int "Max GNSS fix age before gps_ok=false (seconds)"
        default 120
        range 30 600
        depends on NET_LTE_GPS_ENABLE

endmenu
```

## components/transport_http/Kconfig
```kconfig
menu "Fleet HTTP (SoftAP + web UI)"

    config ELM_HTTP_ENABLE
        bool "Enable SoftAP and embedded HTTP API"
        default n
        help
            When disabled, use USB serial and the PC Carrier Console instead.
            Saves flash and avoids Wi-Fi airtime alongside Zigbee.

endmenu
```

## examples/synthetic_uart/sdkconfig.defaults
```kconfig
CONFIG_IDF_TARGET="esp32c6"
CONFIG_ESP_CONSOLE_USB_SERIAL_JTAG=y
# CONFIG_ESP_CONSOLE_UART_DEFAULT is not set
CONFIG_ESP_MAIN_TASK_STACK_SIZE=8192
```

## firmware_v2/master/components/can_obd/Kconfig
```kconfig
menu "Direct CAN OBD (can_obd / MCP2515)"

    config CAN_OBD_SPI_SCK_GPIO
        int "SPI SCK GPIO"
        default 21

    config CAN_OBD_SPI_MOSI_GPIO
        int "SPI MOSI GPIO"
        default 22

    config CAN_OBD_SPI_MISO_GPIO
        int "SPI MISO GPIO"
        default 23

    config CAN_OBD_SPI_CS_GPIO
        int "SPI CS GPIO"
        default 20

    config CAN_OBD_INT_GPIO
        int "MCP2515 INT GPIO (reserved, polled mode for now)"
        default 14

    choice CAN_OBD_XTAL
        prompt "MCP2515 crystal frequency"
        default CAN_OBD_XTAL_8MHZ
        help
            Printed on the metal oscillator of the CAN module
            ("8.000" or "16.000"). Bit timing derives from this.

        config CAN_OBD_XTAL_8MHZ
            bool "8 MHz"
        config CAN_OBD_XTAL_16MHZ
            bool "16 MHz"
    endchoice

    choice CAN_OBD_PROTOCOL
        prompt "OBD protocol selection"
        default CAN_OBD_PROTO_AUTO
        help
            Auto sweeps ISO 15765-4 candidates (11/29-bit x 500/250 kbit)
            until an ECU answers 0100, then persists the winner in NVS.
            Pin a specific protocol only for known-fleet deployments.

        config CAN_OBD_PROTO_AUTO
            bool "Auto-detect (recommended)"
        config CAN_OBD_PROTO_11_500
            bool "11-bit / 500 kbit"
        config CAN_OBD_PROTO_11_250
            bool "11-bit / 250 kbit"
        config CAN_OBD_PROTO_29_500
            bool "29-bit / 500 kbit"
        config CAN_OBD_PROTO_29_250
            bool "29-bit / 250 kbit"
    endchoice

endmenu
```

## firmware_v2/master/components/ota/Kconfig
```kconfig
menu "Cloud OTA (Trafyn get-latest)"

    config OTA_CLOUD_AUTO_CHECK
        bool "Auto-check firmware after LTE is up"
        default y

    config OTA_CLOUD_CHECK_URL
        string "Firmware-check POST URL (fleet-wide; from bin only)"
        default ""
        help
            Set the real URL in firmware_v2/master/sdkconfig.defaults only
            (CONFIG_OTA_CLOUD_CHECK_URL). Do not duplicate here. Not stored in NVS.

    config OTA_CLOUD_AUTH_HEADER
        string "Optional Authorization header value (empty = omit)"
        default ""

    config OTA_CLOUD_SYSTEM_USER_ID
        string "Optional x-nc-system-user-id (empty = omit)"
        default ""

    config OTA_CLOUD_MANUFACTURER
        string "Trafyn manufacturer"
        default "Espressif Systems"

    config OTA_CLOUD_DEVICE_TYPE
        string "Trafyn deviceType"
        default "fleet monitor"

    config OTA_CLOUD_AUTO_WAIT_SEC
        int "Max seconds to wait for LTE before first check"
        range 30 600
        default 90
        depends on OTA_CLOUD_AUTO_CHECK

    config OTA_CLOUD_AUTO_INTERVAL_H
        int "Hours between auto OTA checks"
        range 1 168
        default 4
        depends on OTA_CLOUD_AUTO_CHECK

endmenu
```

## firmware_v2/master/components/store_sd/Kconfig
```kconfig
menu "SD uplink store (store_sd)"

    config STORE_SD_ENABLE
        bool "Mount microSD and enable durable uplink queue"
        default y
        help
            Dedicated SPI pins for SD (defaults SCK4 MOSI5 MISO6 CS18).
            ESP32-C6 has one GPSPI (SPI2); if MCP also uses SPI2 pins, they must not share wires.

    config STORE_SD_CS_GPIO
        int "SD card SPI CS GPIO"
        default 18
        depends on STORE_SD_ENABLE

    config STORE_SD_SCK_GPIO
        int "SD SPI SCK GPIO"
        default 4
        depends on STORE_SD_ENABLE

    config STORE_SD_MOSI_GPIO
        int "SD SPI MOSI GPIO"
        default 5
        depends on STORE_SD_ENABLE

    config STORE_SD_MISO_GPIO
        int "SD SPI MISO GPIO"
        default 6
        depends on STORE_SD_ENABLE

    config STORE_SD_SPI_HZ
        int "SD SPI clock (Hz)"
        default 4000000
        range 400000 20000000
        depends on STORE_SD_ENABLE

    config STORE_SD_MAX_QUEUE_BYTES
        int "Max uplink queue file size (bytes)"
        default 16777216
        range 65536 67108864
        depends on STORE_SD_ENABLE
        help
            When exceeded, oldest records are dropped before append.

    config STORE_SD_BATCH_MAX_EVENTS
        int "Max events per uplink batch POST"
        default 10
        range 1 20
        depends on STORE_SD_ENABLE

    config STORE_SD_BATCH_MAX_BYTES
        int "Max batch POST body size (bytes)"
        default 12288
        range 2048 24576
        depends on STORE_SD_ENABLE

endmenu
```

## firmware_v2/master/components/transport_zigbee/Kconfig
```kconfig
menu "Fleet Zigbee"

config FLEET_ZIGBEE_ENABLE
    bool "Enable Zigbee coordinator transport"
    default n
    help
        Master forms an open Zigbee network and receives host TLV frames.
        When disabled, use transport_zigbee_ingest() for USB loopback tests.

config FLEET_ZIGBEE_CHANNEL
    int "Zigbee channel (11-26)"
    depends on FLEET_ZIGBEE_ENABLE
    range 11 26
    default 15

config FLEET_ZIGBEE_EPAN_ID
    string "Extended PAN ID (16 hex digits, MSB-first)"
    depends on FLEET_ZIGBEE_ENABLE
    default "F1EE700000000001"
    help
        Must match the host FLEET_ZB_EPAN_ID. Unique per truck together with channel.
        Changing this requires erase-flash once so Zigbee NVS does not keep the old network.

endmenu
```

## firmware_v2/master/components/uplink/Kconfig
```kconfig
menu "Telemetry uplink (v2)"

    config UPLINK_URL
        string "POST URL for telemetry events (fleet-wide; from bin only)"
        default ""
        help
            Set the real URL in firmware_v2/master/sdkconfig.defaults only
            (CONFIG_UPLINK_URL). Do not duplicate here. Not stored in NVS.

    config UPLINK_TICK_SEC
        int "Uplink GPS tick interval (seconds)"
        default 30
        range 10 3600

    config UPLINK_VEHICLE_WRAP
        bool "Wrap POST body as {\"Vehicle\":[...envelopes...]}"
        default n
        help
            Off for Trafyn /nc-events-api/v1/sources/nc-fleet-device/messages (bare JSON array).
            Enable only if a backend still requires a top-level Vehicle key.

    config UPLINK_DEVICE_TYPE_OBD
        string "device_type field for OBD (1087) envelopes"
        default "obd"

    config UPLINK_DEVICE_TYPE_GPS
        string "device_type field for GPS (1089) envelopes"
        default "gps"
        help
            Master-owned streams only. Zigbee hosts are dynamic (fuel or any
            new type); their envelopes omit device_type and carry host_type
            in payload — backend keys them by device_id.

endmenu
```

## main/Kconfig.projbuild
```kconfig
menu "Fleet telematics node"

    config ELM_SOFTAP_SSID
        string "SoftAP SSID"
        default "Fleet-C6"

    config ELM_SOFTAP_PASS
        string "SoftAP password"
        default "fleetc6"
        help
            Minimum 8 characters.

    config ELM_CMD_TIMEOUT_MS
        int "OBD command timeout (ms)"
        default 12000
        range 500 30000
        help
            OBD command timeout (ms). Auto protocol search often needs 5-15s.

endmenu
```
